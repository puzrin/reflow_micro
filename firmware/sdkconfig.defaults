## firmware/sdkconfig.defaults
```kconfig
# May be those will be used later.
#CONFIG_COMPILER_OPTIMIZATION_SIZE=y
#CONFIG_PARTITION_TABLE_TWO_OTA=y

#
# Force using USB CDC only for console.
#
CONFIG_ESP_CONSOLE_UART_NONE=y
CONFIG_ESP_CONSOLE_USB_SERIAL_JTAG=y
CONFIG_ESP_CONSOLE_SECONDARY_NONE=y
CONFIG_ESP_CONSOLE_UART_DEFAULT=n

#
# This should be in sync with pio board info, or pio shows warning
#
CONFIG_ESPTOOLPY_FLASHSIZE_4MB=y

#
# FreeRTOS
#

CONFIG_FREERTOS_HZ=1000
CONFIG_FREERTOS_USE_TRACE_FACILITY=y

#
# Other
#

CONFIG_LOG_COLORS=n
CONFIG_COMPILER_CXX_EXCEPTIONS=y
CONFIG_COMPILER_CXX_EXCEPTIONS_EMG_POOL_SIZE=0

#
# NimBLE
#

CONFIG_BT_ENABLED=y
CONFIG_BT_NIMBLE_ENABLED=y
CONFIG_BT_NIMBLE_HOST_TASK_STACK_SIZE=8192
CONFIG_BT_NIMBLE_LOG_LEVEL_WARNING=y

CONFIG_BTDM_CTRL_MODE_BLE_ONLY=y
CONFIG_BTDM_CTRL_MODE_BR_EDR_ONLY=n
CONFIG_BTDM_CTRL_MODE_BTDM=n
```
